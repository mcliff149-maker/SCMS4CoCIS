## firmware/sdkconfig.defaults
```kconfig
CONFIG_ESP_SYSTEM_PANIC_PRINT_REBOOT=y
CONFIG_ESP_MAIN_TASK_STACK_SIZE=8192
CONFIG_FREERTOS_HZ=1000
CONFIG_FATFS_TIMEOUT_MS=1000
```

## sdkconfig.defaults
```kconfig
CONFIG_ESP_TASK_WDT_EN=y
CONFIG_ESP_TASK_WDT_INIT=y
CONFIG_ESP_TASK_WDT_TIMEOUT_S=8
CONFIG_ESP_TASK_WDT_PANIC=y
CONFIG_FATFS_FS_LOCK=4
CONFIG_FATFS_USE_FASTSEEK=n
CONFIG_PARTITION_TABLE_CUSTOM=y
CONFIG_PARTITION_TABLE_CUSTOM_FILENAME="partitions.csv"
CONFIG_ESPTOOLPY_FLASHSIZE_4MB=y
CONFIG_ESP_MAIN_TASK_STACK_SIZE=8192
```
